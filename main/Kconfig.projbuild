## main/Kconfig.projbuild
```kconfig
menu "personCounter App"

menu "General Settings"
config ENABLE_LOGGING
    bool "Enable Logging"
    default y
    help
    Enable ESP logging on the UART output.

choice BOOTLOADER_LOG_LEVEL
    bool "Bootloader Log Level"
    default BOOTLOADER_LOG_LEVEL_ERROR
    help
    Select bootloader log level.

config BOOTLOADER_LOG_LEVEL_NONE
    bool "None log level"
config BOOTLOADER_LOG_LEVEL_ERROR
    bool "Error log level"
config BOOTLOADER_LOG_LEVEL_WARN
    bool "Warning log level"
config BOOTLOADER_LOG_LEVEL_INFO
    bool "Info log level"
config BOOTLOADER_LOG_LEVEL_DEBUG
    bool "Debug log level"
config BOOTLOADER_LOG_LEVEL_VERBOSE
    bool "Verbose log level"
endchoice

config BOOTLOADER_LOG_LEVEL
    int "Bootloader Log Level"
    default 1
    range 0 5
    help
    Set the bootloader log level.

choice LOG_DEFAULT_LEVEL
    bool "Application Log Level"
    default LOG_DEFAULT_LEVEL_INFO
    help
    Select application log level.

config LOG_DEFAULT_LEVEL_NONE
    bool "None log level"
config LOG_DEFAULT_LEVEL_ERROR
    bool "Error log level"
config LOG_DEFAULT_LEVEL_WARN
    bool "Warning log level"
config LOG_DEFAULT_LEVEL_INFO
    bool "Info log level"
config LOG_DEFAULT_LEVEL_DEBUG
    bool "Debug log level"
config LOG_DEFAULT_LEVEL_VERBOSE
    bool "Verbose log level"
endchoice

config LOG_DEFAULT_LEVEL
    int "Application Log Level"
    default 3
    range 0 5
    help
    Set the application log level.
endmenu

menu "WiFi Settings"
config ESP_WIFI_HOST_NAME
    string "WIFI Host Name"
    default ""
    help
    Set the hostname that the WiFi will advertise over mDNS.

config ESP_WIFI_SSID
    string "WiFi STA SSID"
    default ""
    help
    Set WiFi SSID (network name) to connect to or empty for Off.

config ESP_WIFI_PASSWORD
    string "WiFi STA Password"
    default ""
    help
    WiFi Password if WPA/WPA2 or empty if Open.
    Set WiFi SSID (network name) to connect to or empty for Off.

config ESP_WIFI_CONNECT_IPV6
    bool "Obtain IPv6 link-local address"
    default y
    help
    By default, program will wait until IPv4 and IPv6 addresses are obtained.
    Disable this option if the network does not support IPv6.

config ESP_WIFI_AP_SSID
    string "WiFi AP SSID"
    default ""
    help
    Set AP SSID (network name) to create or empty for Off.

config ESP_WIFI_AP_PASSWORD
    string "WiFi AP Password"
    default ""
    help
    Set AP password for WPA2 or empty for Open.

config ESP_WIFI_MAX_STA_CONN
    int "Maximal STA Connections"
    default 1
    help
	Set max number of the STA connects to AP.

config ESP_WIFI_AP_CHANNEL
    string "WiFi AP Channel"
    default ""
    help
    Set AP channel for better connection performance.

config ESP_WIFI_AP_IP
    string "WiFi AP IP Address"
    default "192.168.4.1"
    help
    Set IP address that the ESP will assign to it's AP interface.

config ESP_WIFI_MAXIMUM_RETRY
    int "Maximum Retry"
    default 5
    help
    Set the Maximum retry to avoid station reconnecting to the AP unlimited when the AP is really inexistent.
endmenu

menu "Sensors Setting"
config USE_DUMMY
    bool "Use dummy data"
    default y
    help
    Select Use dummy data.
endmenu

menu "MQTT Setting"
config BROKER_HOST
    string "MQTT broker connexion host"
    default "172.20.10.2"
    help
    Enter MQTT broker connexion host.

config BROKER_PORT
    int "MQTT broker connexion port"
    default 1883
    help
    Enter MQTT broker connexion port.

config DEVICE_ID
    string "MQTT broker device ID"
    default "Default"
    help
    Enter MQTT broker device ID.

config DEVICE_KEY
    string "MQTT broker device key"
    default "default"
    help
    Enter MQTT broker device key.

config BROKER_TOPIC
    string "MQTT broker topic"
    default "iot/dev/%s/data"
    help
    Enter MQTT broker topic.
endmenu

endmenu
```
